## examples/clear/Kconfig
```kconfig
#
# For a description of the syntax of this configuration file,
# see the file kconfig-language.txt in the NuttX tools repository.
#

config EXAMPLES_CLEAR
	tristate "Please clear screen"
	default n
	---help---
		Enable the awesome clear screen command

if EXAMPLES_CLEAR

config EXAMPLES_CLEAR_PROGNAME
	string "Program name"
	default "clear"
	---help---
		This is the name of the program that will be used when the NSH ELF
		program is installed.

config EXAMPLES_CLEAR_PRIORITY
	int "clear task priority"
	default 100

config EXAMPLES_CLEAR_STACKSIZE
	int "clear stack size"
	default DEFAULT_TASK_STACKSIZE

endif
```

## examples/nf_romfs/Kconfig
```kconfig
#
# For a description of the syntax of this configuration file,
# see the file kconfig-language.txt in the NuttX tools repository.
#

config EXAMPLES_NF_ROMFS
	tristate "NF ROMFS .pe local"
	default n
	depends on FS_ROMFS && BUILD_FLAT
	---help---
		Create te ROMFS for .pe storage

if EXAMPLES_ROMFS
endif
```

## interpreters/dotnet/Kconfig
```kconfig
#
# For a description of the syntax of this configuration file,
# see the file kconfig-language.txt in the NuttX tools repository.
#

config DOTNET
	tristate ".NET nanoFramework"
	default n
	---help---
		Enable .NET nanoFramework interpreter

if DOTNET

config DOTNET_PROGNAME
	string "Program name"
	default "dotnet-nf"
	depends on BUILD_KERNEL
	---help---
		This is the name of the program that will be
		 use when the NSH ELF program is installed.

config DOTNET_PRIORITY
	int "dotnet task priority"
	default 100

config DOTNET_STACKSIZE
	int "dotnet stack size"
	default 4096

endif # DOTNET
```
